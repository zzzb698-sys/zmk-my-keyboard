## boards/shields/Kconfig.defconfig
```kconfig
# Copyright (c) 2020 The ZMK Contributors
# SPDX-License-Identifier: MIT

if SHIELD_ZB60

config ZMK_KEYBOARD_NAME
    default "zb60"

endif
```

## boards/shields/Kconfig.shield
```kconfig
# Copyright (c) 2020 The ZMK Contributors
# SPDX-License-Identifier: MIT

config SHIELD_ZB60
    def_bool $(shields_list_contains,zb60)
```
